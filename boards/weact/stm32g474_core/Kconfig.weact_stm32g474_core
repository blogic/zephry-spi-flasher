## boards/weact/stm32g474_core/Kconfig.weact_stm32g474_core
```kconfig
# Copyright (c) 2026 John Crispin <john@phrozen.org>
#
# SPDX-License-Identifier: Apache-2.0

config BOARD_WEACT_STM32G474_CORE
	select SOC_STM32G474XX
```
